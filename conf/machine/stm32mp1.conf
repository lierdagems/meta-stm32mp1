## conf/machine/stm32mp1.conf
```bitbake
#@TYPE: Machine
#@NAME: stm32mp1
#@DESCRIPTION: Machine configuration for STM32MP153a board (Trusted boot)
#@MAINTAINER: hey@lierda.com

# Chip architecture
DEFAULTTUNE = "cortexa7thf-neon-vfpv4"
include conf/machine/include/tune-cortexa7.inc

# support linux
PREFERRED_PROVIDER_virtual/kernel = "linux-stm32mp1"

# linux defconfig
KBUILD_DEFCONFIG = "stm32mp1_defconfig"

# kernel image type
KERNEL_IMAGETYPE = "uImage"

# UBOOT_ENTRYPOINT => make uImage LOADADDR=0xC2000040
UBOOT_ENTRYPOINT = "0xC2000040"

# support u-boot
EXTRA_IMAGEDEPENDS += "u-boot-stm32mp1"
PREFERRED_PROVIDER_virtual/bootloader = "u-boot-stm32mp1"

# u-boot defconfig
UBOOT_MACHINE = "stm32mp15_trusted_defconfig"

# u-boot duffix
UBOOT_SUFFIX = "stm32"

# support tf-a
EXTRA_IMAGEDEPENDS += "tf-a-stm32mp1"

# device tree
STM32MP_DEVICETREE = "stm32mp157c-dk2"
TF_A_DEVICETREE    = "${STM32MP_DEVICETREE}"
UBOOT_DEVICETREE   = "${STM32MP_DEVICETREE}"
KERNEL_DEVICETREE  = "${STM32MP_DEVICETREE}.dtb"

# Default FSTYPES requested
IMAGE_FSTYPES ?= "tar.xz ext4"

# MACHINE_FEATURES += "bluetooth"
# MACHINE_FEATURES += "wifi"
# MACHINE_FEATURES += "alsa"
MACHINE_FEATURES = "usbhost usbgadget ext2"

# Default serial consoles (TTYs) to enable using getty
# Before kernel 4.18, serial console are ttyS3 but after is ttySTM0
SERIAL_CONSOLES = "115200;ttySTM0"

EXTRA_IMAGEDEPENDS += " \
    raw-tools-native \
    "

# TODO: wic
#WKS_FILE_DEPENDS ?= " \
#    u-boot-stm32mp \
#    tf-a-stm32mp \
#    st-image-bootfs \
#    st-image-userfs \
#"

#IMAGE_FSTYPES += "wic"
#WKS_FILE += "sdcard-stm32mp157c-dk2-trusted-1GB.wks"

# TODO: MACHINE_EXTRA_RRECOMMENDS ?
#MACHINE_EXTRA_RRECOMMENDS ?= ""
```

## wic/emmc-stm32mp153a-1GB.wks
```
# short-description: Create EMMC card image with a boot partition (1GB)
# long-description: Creates a partitioned EMMC card image (1GB)
#
# Warning: the first stage of boot (here fsbl1, fsbl2, ssbl) MUST be on GPT partition to be detected.
#
# Number  Start (sector)    End (sector)  Size       Code  Name
#   1            1024            5119   2.0 MiB     8301  ssbl
#   2            5120          136191   64.0 MiB    8300  bootfs
#   3          136192         1673055   750.4 MiB   8300  rootfs
#   4         1673056         3145694   719.1 MiB   8300  userfs
#

part ssbl  --source rawcopy --sourceparams="file=u-boot-stm32mp153a-dk2.stm32" --ondisk mmcblk --label ssbl --part-type 0x8301 --fixed-size 2048K

part bootfs --source rawcopy --sourceparams="file=st-image-bootfs-openstlinux-weston-stm32mp1.ext4" --ondisk mmcblk --fstype=ext4 --label bootfs --active --fixed-size 64M
part / --source rootfs --ondisk mmcblk --fstype=ext4 --label rootfs --fixed-size 768M
part usrfs --source rawcopy --sourceparams="file=st-image-userfs-openstlinux-weston-stm32mp1.ext4" --ondisk mmcblk --fstype=ext4 --label userfs --active --fixed-size 173M

bootloader --ptable gpt
```

## wic/sdcard-stm32mp153a-1GB.wks
```
# short-description: Create SD card image with a boot partition (1GB)
# long-description: Creates a partitioned SD card image (1GB)
#
# Warning: the first stage of boot (here fsbl1, fsbl2, ssbl) MUST be on GPT partition to be detected.
#
# Number  Start (sector)    End (sector)  Size       Code  Name
#   1              34             545   256.0 KiB   8301  fsbl1
#   2             546            1057   256.0 KiB   8301  fsbl2
#   3            1058            5153   2.0 MiB     8301  ssbl
#   4            5154          136225   64.0 MiB    8300  bootfs
#   5          136226         1664033   746.0 MiB   8300  rootfs
#   6         1664034        15126492   6.4 GiB     8300  userfs

part fsbl1 --source rawcopy --fstype=ext4 --fsoptions "noauto" --part-name=fsbl1 --sourceparams="tf-a-stm32mp157c-dk2.stm32" --ondisk mmcblk --part-type 0x8301 --fixed-size 256K --align 17
part fsbl2 --source rawcopy --fstype=ext4 --fsoptions "noauto" --part-name=fsbl2 --sourceparams="tf-a-stm32mp157c-dk2.stm32" --ondisk mmcblk --part-type 0x8301 --fixed-size 256K
part ssbl  --source rawcopy --fstype=ext4 --fsoptions "noauto" --part-name=ssbl --sourceparams="u-boot-stm32mp157c-dk2.stm32" --ondisk mmcblk --part-type 0x8301 --fixed-size 2048K

part bootfs --source rawcopy --sourceparams="file=st-image-bootfs-openstlinux-weston-stm32mp1.ext4" --ondisk mmcblk --fstype=ext4 --label bootfs --active --fixed-size 64M
part vendorfs --source rawcopy --sourceparams="file=st-image-vendorfs-openstlinux-weston-stm32mp1.ext4" --ondisk mmcblk --fstype=ext4 --label vendorfs --active --fixed-size 16M
part / --source rootfs --ondisk mmcblk --fstype=ext4 --label rootfs --fixed-size 768M
part usrfs --source rawcopy --sourceparams="file=st-image-userfs-openstlinux-weston-stm32mp1.ext4" --ondisk mmcblk --fstype=ext4 --label userfs --active --fixed-size 173M

bootloader --ptable gpt
```
